## Documentation/devicetree/bindings/hwlock/hwlock.txt
```
Generic hwlock bindings
=======================

Generic bindings that are common to all the hwlock platform specific driver
implementations, the retrieved values are used for registering the device
specific parameters with the hwspinlock core.

The validity and need of these common properties may vary from one platform
implementation to another. The platform specific bindings should explicitly
state if a property is mandatory or optional. Please look through the
individual platform specific hwlock binding documentations for identifying
the applicable properties.

Common properties:
- #hwlock-cells:	Specifies the number of cells needed to represent a
			specific lock.
- hwlock-num-locks:	Number of locks present in a hwlock device. This
			property is needed on hwlock devices, where the number
			of supported locks within a hwlock device cannot be
			read from a register.

Hwlock Users:
=============

Nodes that require specific hwlock(s) should specify them using one or more
properties, each containing a phandle to the hwlock node and an args specifier
value as indicated by #hwlock-cells. Multiple hwlocks can be requested using
an array of the phandle and hwlock number specifier tuple.

1. Example of a node using a single specific hwlock:

The following example has a node requesting a hwlock in the bank defined by
the node hwlock1. hwlock1 is a hwlock provider with an argument specifier
of length 1.

	node {
		...
		hwlocks = <&hwlock1 2>;
		...
	};

2. Example of a node using multiple specific hwlocks:

The following example has a node requesting two hwlocks, a hwlock within
the hwlock device node 'hwlock1' with #hwlock-cells value of 1, and another
hwlock within the hwlock device node 'hwlock2' with #hwlock-cells value of 2.

	node {
		...
		hwlocks = <&hwlock1 2>, <&hwlock2 0 3>;
		...
	};
```

## Documentation/devicetree/bindings/hwlock/omap-hwspinlock.txt
```
OMAP4+ HwSpinlock Driver
========================

Required properties:
- compatible:		Should be "ti,omap4-hwspinlock" for
			    OMAP44xx, OMAP54xx, AM33xx, AM43xx, DRA7xx SoCs
- reg:			Contains the hwspinlock module register address space
			(base address and length)
- ti,hwmods:		Name of the hwmod associated with the hwspinlock device
- hwlock-base-id:	Should be 0 for the first IP block instance, or a proper
			positive value for any subsequent instance (if present)
			of the IP block.
- #hwlock-cells:	Should be 1. The OMAP hwspinlock users will use a
			0-indexed relative hwlock number as the argument
			specifier value for requesting a specific hwspinlock
			within a hwspinlock bank.


Example:

/* OMAP4 */
hwspinlock: spinlock@4a0f6000 {
	compatible = "ti,omap4-hwspinlock";
	reg = <0x4a0f6000 0x1000>;
	ti,hwmods = "spinlock";
	hwlock-base-id = <0>;
	#hwlock-cells = <1>;
};
```

## Documentation/devicetree/bindings/iommu/ti,omap-iommu.txt
```
OMAP2+ IOMMU

Required properties:
- compatible : Should be one of,
		"ti,omap2-iommu" for OMAP2/OMAP3 IOMMU instances
		"ti,omap4-iommu" for OMAP4/OMAP5 IOMMU instances
- ti,hwmods  : Name of the hwmod associated with the IOMMU instance
- reg        : Address space for the configuration registers
- interrupts : Interrupt specifier for the IOMMU instance
- dma-window : IOVA start address and length

Optional properties:
- ti,#tlb-entries : Number of entries in the translation look-aside buffer.
                    Should be either 8 or 32 (default: 32)

Example:
	/* OMAP3 ISP MMU */
	mmu_isp: mmu_isp@480bd400 {
		compatible = "ti,omap2-iommu";
		reg = <0x480bd400 0x80>;
		interrupts = <24>;
		ti,hwmods = "mmu_isp";
		ti,#tlb-entries = <8>;
		dma-window = <0 0xfffff000>;
	};
```

## drivers/hwspinlock/Kconfig
```kconfig
#
# Generic HWSPINLOCK framework
#

# HWSPINLOCK always gets selected by whoever wants it.
config HWSPINLOCK
	tristate

menu "Hardware Spinlock drivers"

config HWSPINLOCK_OMAP
	tristate "OMAP Hardware Spinlock device"
	depends on ARCH_OMAP4 || SOC_OMAP5 || SOC_DRA7XX || SOC_AM33XX || SOC_AM43XX
	select HWSPINLOCK
	help
	  Say y here to support the OMAP Hardware Spinlock device (firstly
	  introduced in OMAP4).

	  If unsure, say N.

config HWSPINLOCK_OMAP_TEST
	tristate "OMAP Hardware Spinlock test driver"
	depends on HWSPINLOCK_OMAP
	default m
	help
	  Say Y here to perform tests on the OMAP hwspinlock implementation.
          It is recommended to build this test as a module always.

	  Say N, unless you absolutely know what you are doing.

config HSEM_U8500
	tristate "STE Hardware Semaphore functionality"
	depends on ARCH_U8500
	select HWSPINLOCK
	help
	  Say y here to support the STE Hardware Semaphore functionality, which
	  provides a synchronisation mechanism for the various processor on the
	  SoC.

	  If unsure, say N.

endmenu
```
